#include "Oled.h"
#include "stm32f4xx_hal.h"

// Includi altri header per HAL, GPIO...


// OLED::OLED(I2C_HandleTypeDef* i2cHandle) : i2cDevicePtr(i2cHandle) {
//     // eventuale codice aggiuntivo del costruttore
// }

void OLED::sendCommand(uint8_t command) {
    uint8_t control = 0x00; // Co = 0, D/C# = 0
    uint8_t data[2] = { control, command };
    HAL_I2C_Master_Transmit(i2cDevicePtr, OLED_ADDR, data, 2, HAL_MAX_DELAY);
}

void OLED::sendData(uint8_t data) {
    uint8_t control = 0x40; // Co = 0, D/C# = 1
    uint8_t databyte[2] = { control, data };
    HAL_I2C_Master_Transmit(i2cDevicePtr, OLED_ADDR, databyte, 2, HAL_MAX_DELAY);
}

void OLED::init() {
    HAL_Delay(100);
    sendCommand(0xAE); // display off
    sendCommand(0xD5);
    sendCommand(0x80);
    sendCommand(0xA8);
    sendCommand(0x3F);
    sendCommand(0xD3);
    sendCommand(0x00);
    sendCommand(0x40);
    sendCommand(0x8D);
    sendCommand(0x14);
    sendCommand(0x20);
    sendCommand(0x00);
    sendCommand(0xA1);
    sendCommand(0xC8);
    sendCommand(0xDA);
    sendCommand(0x12);
    sendCommand(0x81);
    sendCommand(0xCF);
    sendCommand(0xD9);
    sendCommand(0xF1);
    sendCommand(0xDB);
    sendCommand(0x40);
    sendCommand(0xA4);
    sendCommand(0xA6);
    sendCommand(0xAF);

}

void OLED::fill(uint8_t pattern) {
    for (uint8_t page = 0; page < 8; page++) {
        sendCommand(0xB0 + page);
        sendCommand(0x00);
        sendCommand(0x10);
        for (uint8_t col = 0; col < 128; col++) {
            sendData(pattern);
        }
    }
}

void OLED::setCursor(uint8_t x, uint8_t y) {
    sendCommand(0xB0 + y);
    sendCommand(0x00 + (x & 0x0F));
    sendCommand(0x10 + (x >> 4));
}

void OLED::drawChar(uint8_t x, uint8_t y, char c) {
    if (c < 0x20 || c > 0x7F) c = '?';
    setCursor(x, y);
    for (int i = 0; i < 5; i++) {
        sendData(font5x7[c - 0x20][i]);
    }
    sendData(0x00);
}

void OLED::print(uint8_t x, uint8_t y, const char* str) {
    while (*str) {
        drawChar(x, y, *str++);
        x += 6;
        if (x + 6 >= OLED_WIDTH) {
            x = 0;
            y++;
        }
        if (y >= 8) break;
    }
}

void OLED::clearArea(uint8_t x, uint8_t y, uint8_t width, uint8_t height) {
    for (uint8_t page = y; page < y + height; page++) {
        setCursor(x, page);
        for (uint8_t col = 0; col < width; col++) {
            sendData(0x00);
        }
    }
}

void OLED::drawBitmap(const unsigned char* bitmap, uint8_t x, uint8_t y, uint8_t width, uint8_t height) {
    // for (uint8_t page = 0; page < 8; page++) {
    //     setCursor(0, page);
    //     for (uint8_t col = 0; col < 128; col++) {
    //         sendData(bitmap[page * 128 + col]);
    //     }
    // }
    
    uint8_t pages = (height + 7) / 8;
    for (uint8_t page = 0; page < pages; page++) {
        setCursor(x, y + page);
        for (uint8_t col = 0; col < width; col++) {
            sendData(bitmap[page * width + col]);
        }
    }
    

    
}
// Definizione della matrice del font 5x7
const uint8_t OLED::font5x7[96][5] = 
    {
    // ASCII 0x20 (space) - 0x7F (~)
    {0x00,0x00,0x00,0x00,0x00}, // ' '
    {0x00,0x00,0x5F,0x00,0x00}, // '!'
    {0x00,0x07,0x00,0x07,0x00}, // '"'
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    {0x10,0x08,0x08,0x10,0x08}, // '~'
    };

   